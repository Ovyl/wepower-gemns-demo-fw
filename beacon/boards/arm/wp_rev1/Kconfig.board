## beacon/boards/arm/wp_rev1/Kconfig.board
```kconfig
# Copyright (c) 2022 Nordic Semiconductor ASA
# SPDX-License-Identifier: Apache-2.0

config BOARD_WP_REV1
	bool "WP-Rev1"
	depends on SOC_NRF52840_QIAA
```

## beacon/boards/arm/wp_rev1/Kconfig.defconfig
```kconfig
# Copyright (c) 2022 Nordic Semiconductor ASA
# SPDX-License-Identifier: Apache-2.0

if BOARD_WP_REV1

config BOARD
	default "wp_rev1"

config BT_CTLR
   default BT

endif
```
